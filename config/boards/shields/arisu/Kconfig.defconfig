## config/west.yml
```yaml
manifest:
  defaults:
    # remote: hufngng
    revision: v0.3
  remotes:
    # - name: hufngng
    #   url-base: https://github.com/hufngng
    - name: zmkfirmware
      url-base: https://github.com/zmkfirmware
  projects:
    - name: zmk
      remote: zmkfirmware
      import: app/west.yml   
  self:
    path: config
```
